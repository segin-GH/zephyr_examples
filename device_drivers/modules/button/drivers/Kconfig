## device_drivers/modules/button/drivers/button/Kconfig
```kconfig
# Create a new option in menuconfig
config SIMPLE_BUTTON
    bool "Simple button"
    default n       # Set the driver to be disabled by default
    depends on GPIO # Make it dependent on GPIO driver
    help
        Enable the custom button driver.
```

## device_drivers/modules/button/dts/bindings/input/simple,button.yaml
```yaml
description: Simple button

compatible: "simple,button"

properties:
  pin:
    type: phandle
    required: true
```
